## hardware/lantern-firmware/main/Kconfig.projbuild
```kconfig
menu "Lantern hardware"

choice LANTERN_BOARD
    prompt "Lantern board profile"
    default LANTERN_BOARD_ZHENGCHEN_M1307
    help
        Select the physical board this firmware image targets. Application,
        session, voice, and network code is shared; only the hardware profile
        supplies pins and capabilities.

config LANTERN_BOARD_ZHENGCHEN_M1307
    bool "Lantern Original (ZHENGCHEN 1.54-inch M1307)"

config LANTERN_BOARD_ES3C28P
    bool "Lantern V2 (LCDWiki ES3C28P 2.8-inch touch)"

endchoice

endmenu
```

## hardware/lantern-firmware/sdkconfig.defaults
```kconfig
CONFIG_PARTITION_TABLE_CUSTOM=y
CONFIG_PARTITION_TABLE_CUSTOM_FILENAME="partitions.csv"
CONFIG_ESPTOOLPY_FLASHSIZE_16MB=y
CONFIG_ESPTOOLPY_FLASHMODE_QIO=y
CONFIG_ESPTOOLPY_FLASHFREQ_80M=y
CONFIG_ESPTOOLPY_MONITOR_BAUD_115200B=y

CONFIG_SPIRAM=y
CONFIG_SPIRAM_MODE_OCT=y
CONFIG_SPIRAM_TYPE_AUTO=y
CONFIG_SPIRAM_SPEED_80M=y
CONFIG_SPIRAM_USE_MALLOC=y
CONFIG_SPIRAM_MALLOC_ALWAYSINTERNAL=4096

CONFIG_MBEDTLS_CERTIFICATE_BUNDLE=y
CONFIG_MBEDTLS_CERTIFICATE_BUNDLE_DEFAULT_FULL=y
CONFIG_ESP_MAIN_TASK_STACK_SIZE=12288
CONFIG_FREERTOS_HZ=1000
```
